## sdkconfig.defaults
```kconfig
CONFIG_BLINK_LED_GPIO=y
CONFIG_BLINK_GPIO=8

# Bluetooth configuration
CONFIG_BT_ENABLED=y
CONFIG_BT_BLUEDROID_ENABLED=y
CONFIG_BT_BLE_ENABLED=y
CONFIG_BT_GATTS_ENABLE=y
CONFIG_BT_BLE_42_FEATURES_SUPPORTED=y
CONFIG_BT_BLE_50_FEATURES_SUPPORTED=n
```
